## config/boards/shields/chonky_trackball_less/Kconfig.defconfig
```kconfig
if SHIELD_CHONKY_TRACKBALL_LESS_DONGLE

config ZMK_KEYBOARD_NAME
    default "Chonky Dongle"

config ZMK_SPLIT_ROLE_CENTRAL
    default y

config ZMK_USB
    default y

config ZMK_SPLIT
    default y

# Set this to the number of peripherals your dongle will have.
# For a unibody, this would be 1. If you have left and right halves, set it to 2, etc.
config ZMK_SPLIT_BLE_CENTRAL_PERIPHERALS
    default 3

# Set this to ZMK_SPLIT_BLE_CENTRAL_PERIPHERALS + your desired number of BT profiles (default is 5)
config BT_MAX_CONN
    default 3

# Set this to the same number as BT_MAX_CONN
config BT_MAX_PAIRED
    default 3

endif

if SHIELD_CHONKY_TRACKBALL_LESS_LEFT || SHIELD_CHONKY_TRACKBALL_LESS_RIGHT || SHIELD_CHONKY_TRACKBALL_LESS_DONGLE || SHIELD_CHONKY_TRACKBALL_LESS_MOUSE

config ZMK_SPLIT
    default y

config ZMK_BLE
    default y

endif
```

## config/boards/shields/chonky_trackball_less/Kconfig.shield
```kconfig
# Copyright (c) 2020 Pete Johanson
config SHIELD_CHONKY_TRACKBALL_LESS_LEFT
    def_bool $(shields_list_contains,chonky_trackball_less_left)

config SHIELD_CHONKY_TRACKBALL_LESS_RIGHT
    def_bool $(shields_list_contains,chonky_trackball_less_right)

config SHIELD_CHONKY_TRACKBALL_LESS_DONGLE
    def_bool $(shields_list_contains,chonky_trackball_less_dongle)
```
